## board/samsung/gprime/Kconfig
```kconfig
if TARGET_SC8830_GPRIME

config SYS_BOARD
    default "gprime"

config SYS_VENDOR
    default "samsung"

config SYS_SOC
    default "sc8830"

config SYS_CONFIG_NAME
    default "sc8830_gprime"

endif
```

## configs/meson6_generic_defconfig
```kconfig
CONFIG_ARCH_MESON=y
CONFIG_MESON6=y
CONFIG_BAUDREATE=115200
CONFIG_TARGET_MESON6_GENERIC=y
CONFIG_DEFAULT_DEVICE_TREE="meson-meson6-gamestick"
CONFIG_OF_CONTROL=y
CONFIG_OF_SEPARATE=y
```

## configs/sc8830_gprime_defconfig
```kconfig
CONFIG_ARM=y
# CONFIG_ARM64 is not set
CONFIG_ARCH_SC8830=y
CONFIG_CPU_V7A=y
CONFIG_TARGET_SC8830_GPRIME=y
CONFIG_TEXT_BASE=0x80008000
CONFIG_SYS_LOAD_ADDR=0x82000000
CONFIG_CUSTOM_SYS_INIT_SP_ADDR=0x80100000
CONFIG_DEFAULT_DEVICE_TREE="sc8830-gprime"
CONFIG_DM_SERIAL=y
CONFIG_SERIAL_SPRD=y
CONFIG_BAUDRATE=115200
CONFIG_SYS_ARCH_TIMER=y
CONFIG_SYS_HZ_CLOCK=26000000
CONFIG_DISPLAY_CPUINFO=y
```
